// SPDX-License-Identifier: GPL-2.0
//
// Copyright 2018 Technexion Ltd.
//
// Author: Wig Cheng <wig.cheng@technexion.com>
//	   Richard Hu <richard.hu@technexion.com>
//	   Tapani Utriainen <tapani@technexion.com>

/dts-v1/;

#include "imx6q.dtsi"
#include "imx6qdl-edm.dtsi"

/ {
	model = "TechNexion EDM-IMX6 Quad";
	compatible = "technexion,imx6q-edm", "fsl,imx6q";
};

&sata {
	status = "okay";
	fsl,transmit-level-mV = <1104>;
	fsl,transmit-boost-mdB = <0>;
	fsl,transmit-atten-16ths = <9>;
	fsl,no-spread-spectrum;
};
