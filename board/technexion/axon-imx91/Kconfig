## board/technexion/axon-imx91/Kconfig
```kconfig
if TARGET_AXON_IMX91

config SYS_BOARD
	default "axon-imx91"

config SYS_VENDOR
	default "technexion"

config SYS_CONFIG_NAME
	default "axon-imx91"

config IMX91_AXON_LPDDR4
	bool "Using LPDDR4 Timing and PMIC voltage"
	default y
	select IMX9_LPDDR4X
	help
	  Select the LPDDR4 timing and 1.1V VDDQ

source "board/technexion/common/Kconfig"

endif
```

## board/technexion/edge-ai-imx95/Kconfig
```kconfig
if TARGET_EDGE_AI_IMX95

config SYS_BOARD
	default "edge-ai-imx95"

config SYS_VENDOR
	default "technexion"

config SYS_CONFIG_NAME
	default "edge-ai-imx95"

endif
```

## board/technexion/edm-e-imx93/Kconfig
```kconfig
if TARGET_EDM_E_IMX93

config SYS_BOARD
	default "edm-e-imx93"

config SYS_VENDOR
	default "technexion"

config SYS_CONFIG_NAME
	default "edm-e-imx93"

config EDM_E_IMX93_LPDDR4X
	bool "Using LPDDR4X Timing and PMIC voltage"
	select IMX9_LPDDR4X
	help
	  Select the LPDDR4X timing and 0.6V VDDQ

source "board/technexion/common/Kconfig"

endif
```

## board/technexion/edm-imx91/Kconfig
```kconfig
if TARGET_EDM_IMX91

config SYS_BOARD
	default "edm-imx91"

config SYS_VENDOR
	default "technexion"

config SYS_CONFIG_NAME
	default "edm-imx91"

config IMX91_EDM_LPDDR4
	bool "Using LPDDR4 Timing and PMIC voltage"
	default y
	select IMX9_LPDDR4X
	help
	  Select the LPDDR4 timing and 1.1V VDDQ

source "board/technexion/common/Kconfig"

endif
```

## board/technexion/edm-imx95/Kconfig
```kconfig
if TARGET_EDM_IMX95

config SYS_BOARD
	default "edm-imx95"

config SYS_VENDOR
	default "technexion"

config SYS_CONFIG_NAME
	default "edm-imx95"

source "board/technexion/common/Kconfig"

endif
```
