## board/technexion/pico-imx8mm/Kconfig
```kconfig
if TARGET_PICO_IMX8MM

config SYS_BOARD
	default "pico-imx8mm"

config SYS_VENDOR
	default "technexion"

config SYS_CONFIG_NAME
	default "pico-imx8mm"

source "board/technexion/common/Kconfig"

endif
```

## board/technexion/pico-imx8mm/tnrescue.its
```
/*
 * U-Boot uImage source file with multiple kernels, ramdisks and FDT blobs
 */

/dts-v1/;

/ {
	description = "Various kernels, ramdisks and FDT blobs";
	#address-cells = <1>;

	images {
		kernel@1 {
			description = "Technexion IMX8 Linux Kernel";
			data = /incbin/("./Image");
			type = "kernel";
			arch = "arm64";
			os = "linux";
			compression = "none";
			load = <0x40480000>;
			entry = <0x40480000>;
			hash@1 {
				algo = "sha1";
			};
		};

		ramdisk@1 {
			description = "Technexion Installer Ramdisk with Qt";
			data = /incbin/("./rootfs.cpio.xz");
			type = "ramdisk";
			arch = "arm64";
			os = "linux";
			compression = "none";
			hash@1 {
				algo = "sha1";
			};
		};

		fdt@1 {
			description = "Pico imx8mm flat device tree blob for no display";
			data = /incbin/("./dtb/imx8mm-pico-pi.dtb");
			type = "flat_dt";
			arch = "arm64";
			compression = "none";
			hash@1 {
				algo = "sha1";
			};
		};

		fdt@2 {
			description = "Pico imx8mm flat device tree blob for MIPI 5 inch panel";
			data = /incbin/("./dtb/imx8mm-pico-pi-ili9881c.dtb");
			type = "flat_dt";
			arch = "arm64";
			compression = "none";
			hash@1 {
				algo = "sha1";
			};
		};

		fdt@3 {
			description = "Pico imx8mm flat device tree blob for MIPI 8 inch panel";
			data = /incbin/("./dtb/imx8mm-pico-pi-g080uan01.dtb");
			type = "flat_dt";
			arch = "arm64";
			compression = "none";
			hash@1 {
				algo = "sha1";
			};
		};

		fdt@4 {
			description = "Pico imx8mm flat device tree blob for MIPI 10 inch panel";
			data = /incbin/("./dtb/imx8mm-pico-pi-g101uan02.dtb");
			type = "flat_dt";
			arch = "arm64";
			compression = "none";
			hash@1 {
				algo = "sha1";
			};
		};

		fdt@5 {
			description = "Pico imx8mm flat device tree blob for MIPI-LVDS bridge to 7 inch panel";
			data = /incbin/("./dtb/imx8mm-pico-pi-sn65dsi84-hj070na.dtb");
			type = "flat_dt";
			arch = "arm64";
			compression = "none";
			hash@1 {
				algo = "sha1";
			};
		};

		fdt@6 {
			description = "Pico imx8mm flat device tree blob for MIPI-LVDS bridge to 10 inch panel";
			data = /incbin/("./dtb/imx8mm-pico-pi-sn65dsi84-m101nwwb.dtb");
			type = "flat_dt";
			arch = "arm64";
			compression = "none";
			hash@1 {
				algo = "sha1";
			};
		};

		fdt@7 {
			description = "Pico imx8mm flat device tree blob for MIPI 5' panel overlay";
			data = /incbin/("./dtb/imx8mm-pico-pi-mipi_5.dtbo");
			type = "flat_dt";
			arch = "arm64";
			compression = "none";
			hash@1 {
				algo = "sha1";
			};
		};

		fdt@8 {
			description = "Pico imx8mm flat device tree blob for MIPI to HDMI";
			data = /incbin/("./dtb/imx8mm-pico-wizard-adv7535.dtb");
			type = "flat_dt";
			arch = "arm64";
			compression = "none";
			hash@1 {
				algo = "sha1";
			};
		};

		fdt@9 {
			description = "Pico imx8mm flat device tree blob for MIPI 5 inch";
			data = /incbin/("./dtb/imx8mm-pico-wizard-ili9881c.dtb");
			type = "flat_dt";
			arch = "arm64";
			compression = "none";
			hash@1 {
				algo = "sha1";
			};
		};

		fdt@10 {
			description = "Pico imx8mm flat device tree blob for MIPI 8 inch";
			data = /incbin/("./dtb/imx8mm-pico-wizard-g080uan01.dtb");
			type = "flat_dt";
			arch = "arm64";
			compression = "none";
			hash@1 {
				algo = "sha1";
			};
		};

		fdt@11 {
			description = "Pico imx8mm flat device tree blob for MIPI 10 inch";
			data = /incbin/("./dtb/imx8mm-pico-wizard-g101uan02.dtb");
			type = "flat_dt";
			arch = "arm64";
			compression = "none";
			hash@1 {
				algo = "sha1";
			};
		};

		fdt@12 {
			description = "Pico imx8mm flat device tree blob for MIPI LVDS BRIDGE 10 inch";
			data = /incbin/("./dtb/imx8mm-pico-wizard-sn65dsi84-m101nwwb.dtb");
			type = "flat_dt";
			arch = "arm64";
			compression = "none";
			hash@1 {
				algo = "sha1";
			};
		};
	};

	configurations {
		conf@imx8mm-pico-pi.dtb {
			description = "Boot IMX8mm PI with MIPI";
			kernel = "kernel@1";
			ramdisk = "ramdisk@1";
			fdt = "fdt@1";
		};
		conf@imx8mm-pico-pi-ili9881c.dtb {
			description = "Boot IMX8mm PI with 5' mipi";
			kernel = "kernel@1";
			ramdisk = "ramdisk@1";
			fdt = "fdt@2";
		};
		conf@imx8mm-pico-pi-g080uan01.dtb {
			description = "Boot IMX8mm PI with 8' mipi";
			kernel = "kernel@1";
			ramdisk = "ramdisk@1";
			fdt = "fdt@3";
		};
		conf@imx8mm-pico-pi-g101uan02.dtb {
			description = "Boot IMX8mm PI with 10' mipi";
			kernel = "kernel@1";
			ramdisk = "ramdisk@1";
			fdt = "fdt@4";
		};
		conf@imx8mm-pico-pi-sn65dsi84-hj070na.dtb {
			description = "Boot IMX8mm PI with bridged lvds 7' panel";
			kernel = "kernel@1";
			ramdisk = "ramdisk@1";
			fdt = "fdt@5";
		};
		conf@imx8mm-pico-pi-sn65dsi84-m101nwwb.dtb {
			description = "Boot IMX8mm PI with bridged lvds 10' panel";
			kernel = "kernel@1";
			ramdisk = "ramdisk@1";
			fdt = "fdt@6";
		};
		conf@imx8mm-pico-pi-mipi5.dtb {
			description = "Boot IMX8mm PI with bridged lvds 10' panel";
			kernel = "kernel@1";
			ramdisk = "ramdisk@1";
			fdt = "fdt@1", "fdt@7";
		};
		mipi5 {
			description = "5 inch panel overlay";
			fdt = "fdt@7";
		};
		conf@imx8mm-pico-wizard-adv7535.dtb {
			description = "Boot IMX8mm WIZARD with HDMI bridge";
			kernel = "kernel@1";
			ramdisk = "ramdisk@1";
			fdt = "fdt@8";
		};
		conf@imx8mm-pico-wizard-ili9881c.dtb {
			description = "Boot IMX8mm WIZARD with MIPI 5' panel";
			kernel = "kernel@1";
			ramdisk = "ramdisk@1";
			fdt = "fdt@9";
		};
		conf@imx8mm-pico-wizard-g080uan01.dtb {
			description = "Boot IMX8mm WIZARD with MIPI 8' panel";
			kernel = "kernel@1";
			ramdisk = "ramdisk@1";
			fdt = "fdt@10";
		};
		conf@imx8mm-pico-wizard-g101uan02.dtb {
			description = "Boot IMX8mm WIZARD with MIPI 10' panel";
			kernel = "kernel@1";
			ramdisk = "ramdisk@1";
			fdt = "fdt@11";
		};
		conf@imx8mm-pico-wizard-sn65dsi84-m101nwwb.dtb {
			description = "Boot IMX8mm WIZARD with MIPI to LVDS Bridge 10' panel";
			kernel = "kernel@1";
			ramdisk = "ramdisk@1";
			fdt = "fdt@12";
		};
	};
};
```

## board/technexion/pico-imx8mq/tnrescue.its
```
/*
 * U-Boot uImage source file with multiple kernels, ramdisks and FDT blobs
 */

/dts-v1/;

/ {
	description = "Various kernels, ramdisks and FDT blobs";
	#address-cells = <1>;

	images {
		kernel@1 {
			description = "Technexion IMX8mq Linux Kernel";
			data = /incbin/("./Image");
			type = "kernel";
			arch = "arm64";
			os = "linux";
			compression = "none";
			load = <0x40480000>;
			entry = <0x40480000>;
			hash@1 {
				algo = "sha1";
			};
		};

		fdt@1 {
			description = "Pico imx8m flat device tree blob for HDMI";
			data = /incbin/("./dtb/imx8mq-pico-pi.dtb");
			type = "flat_dt";
			arch = "arm64";
			compression = "none";
			hash@1 {
				algo = "sha1";
			};
		};

		fdt@2 {
			description = "Pico imx8m flat device tree blob for MIPI DSI";
			data = /incbin/("./dtb/imx8mq-pico-pi-dcss-ili9881c.dtb");
			type = "flat_dt";
			arch = "arm64";
			compression = "none";
			hash@1 {
				algo = "sha1";
			};
		};

		fdt@3 {
			description = "Pico imx8m flat device tree blob for DUAL display";
			data = /incbin/("./dtb/imx8mq-pico-pi-dual.dtb");
			type = "flat_dt";
			arch = "arm64";
			compression = "none";
			hash@1 {
				algo = "sha1";
			};
		};

		fdt@6 {
			description = "Pico imx8m flat device tree blob for MIPI-LVDS bridge and 7' panel";
			data = /incbin/("./dtb/imx8mq-pico-pi-dcss-sn65dsi84-hj070na.dtb");
			type = "flat_dt";
			arch = "arm64";
			compression = "none";
			hash@1 {
				algo = "sha1";
			};
		};

		fdt@7 {
			description = "pico imx8mq for 8' MIPI";
			data = /incbin/("./dtb/imx8mq-pico-pi-dcss-g080uan01.dtb");
			type = "flat_dt";
			arch = "arm64";
			compression = "none";
			hash@1 {
				algo = "sha1";
			};
		};

		fdt@8 {
			description = "pico imx8mq for 10' MIPI";
			data = /incbin/("./dtb/imx8mq-pico-pi-dcss-g101uan02.dtb");
			type = "flat_dt";
			arch = "arm64";
			compression = "none";
			hash@1 {
				algo = "sha1";
			};
		};

		fdt@9 {
			description = "pico imx8mq wizard";
			data = /incbin/("./dtb/imx8mq-pico-wizard.dtb");
			type = "flat_dt";
			arch = "arm64";
			compression = "none";
			hash@1 {
				algo = "sha1";
			};
		};

		fdt@10 {
			description = "pico imx8mq wizard with 5 inch MIPI";
			data = /incbin/("./dtb/imx8mq-pico-wizard-dcss-ili9881c.dtb");
			type = "flat_dt";
			arch = "arm64";
			compression = "none";
			hash@1 {
				algo = "sha1";
			};
		};

		fdt@11 {
			description = "pico imx8mq wziard with 8 inch MIPI";
			data = /incbin/("./dtb/imx8mq-pico-wizard-dcss-g080uan01.dtb");
			type = "flat_dt";
			arch = "arm64";
			compression = "none";
			hash@1 {
				algo = "sha1";
			};
		};

		fdt@12 {
			description = "pico imx8mq wziard with 10 inch MIPI";
			data = /incbin/("./dtb/imx8mq-pico-wizard-dcss-g101uan02.dtb");
			type = "flat_dt";
			arch = "arm64";
			compression = "none";
			hash@1 {
				algo = "sha1";
			};
		};

		fdt@13 {
			description = "pico imx8mq wziard with 7 inch lcd";
			data = /incbin/("./dtb/imx8mq-pico-wizard-lcdif-adv7535.dtb");
			type = "flat_dt";
			arch = "arm64";
			compression = "none";
			hash@1 {
				algo = "sha1";
			};
		};

		ramdisk@1 {
			description = "Technexion Installer Ramdisk with Qt";
			data = /incbin/("./rootfs.cpio.xz");
			type = "ramdisk";
			arch = "arm64";
			os = "linux";
			compression = "none";
			hash@1 {
				algo = "sha1";
			};
		};
	};

	configurations {
		conf@imx8mq-pico-pi.dtb {
			description = "Boot IMX8mq with HDMI";
			kernel = "kernel@1";
			ramdisk = "ramdisk@1";
			fdt = "fdt@1";
		};

		conf@imx8mq-pico-pi-dcss-ili9881c.dtb {
			description = "Boot IMX8mq with MIPI DSI";
			kernel = "kernel@1";
			ramdisk = "ramdisk@1";
			fdt = "fdt@2";
		};

		conf@imx8mq-pico-pi-dual.dtb {
			description = "Boot IMX8mq with DUAL Display";
			kernel = "kernel@1";
			ramdisk = "ramdisk@1";
			fdt = "fdt@3";
		};

		conf@imx8mq-pico-pi-dcss-sn65dsi84-hj070na.dtb {
			description = "Boot IMX8mq with lcdif to mipi-lvds bridge 7' panel";
			kernel = "kernel@1";
			ramdisk = "ramdisk@1";
			fdt = "fdt@6";
		};

		conf@imx8mq-pico-pi-dcss-g080uan01.dtb {
			description = "Boot IMX8mq with 8' MIPI";
			kernel = "kernel@1";
			ramdisk = "ramdisk@1";
			fdt = "fdt@7";
		};

		conf@imx8mq-pico-pi-dcss-g101uan02.dtb {
			description = "Boot IMX8mq with 10' MIPI";
			kernel = "kernel@1";
			ramdisk = "ramdisk@1";
			fdt = "fdt@8";
		};

		conf@imx8mq-pico-wizard.dtb {
			description = "Boot IMX8mq wizard with HDMI";
			kernel = "kernel@1";
			ramdisk = "ramdisk@1";
			fdt = "fdt@9";
		};

		conf@imx8mq-pico-wizard-dcss-ili9881c.dtb {
			description = "pico imx8mq wizard with 5 inch MIPI";
			kernel = "kernel@1";
			ramdisk = "ramdisk@1";
			fdt = "fdt@10";
		};

		conf@imx8mq-pico-wizard-dcss-g080uan01.dtb {
			description = "pico imx8mq wizard with 8 inch MIPI";
			kernel = "kernel@1";
			ramdisk = "ramdisk@1";
			fdt = "fdt@11";
		};

		conf@imx8mq-pico-wizard-dcss-g101uan02.dtb {
			description = "pico imx8mq wizard with 10 inch MIPI";
			kernel = "kernel@1";
			ramdisk = "ramdisk@1";
			fdt = "fdt@12";
		};

		conf@imx8mq-pico-wizard-lcdif-adv7535.dtb {
			description = "pico imx8mq wizard with 7 inch lcd";
			kernel = "kernel@1";
			ramdisk = "ramdisk@1";
			fdt = "fdt@13";
		};
	};
};
```

## board/technexion/picosom-imx6-android/Kconfig
```kconfig
if TARGET_PICOSOM_IMX6_ANDROID

config SYS_CPU
	default "armv7"

config SYS_BOARD
	default "picosom-imx6-android"

config SYS_VENDOR
	string
	default "technexion"

config SYS_SOC
	default "mx6"

config SYS_CONFIG_NAME
	default "picosom-imx6-android"

endif
```

## board/technexion/sbc-imx6dl/Kconfig
```kconfig
if TARGET_SBC_IMX6DL

config SYS_CPU
	default "armv7"

config SYS_BOARD
	default "sbc-imx6dl"

config SYS_VENDOR
	default "technexion"

config SYS_SOC
	default "mx6"

config SYS_CONFIG_NAME
	default "sbc-imx6dl"

endif
```

## board/technexion/sc-imx8mp/Kconfig
```kconfig
if TARGET_SC_IMX8MP

config SYS_BOARD
	default "sc-imx8mp"

config SYS_VENDOR
	default "technexion"

config SYS_CONFIG_NAME
	default "sc-imx8mp"

endif
```

## board/technexion/tek-imx6/Kconfig
```kconfig
if TARGET_TEK_IMX6

config SYS_BOARD
	default "tek-imx6"

config SYS_VENDOR
	string
	default "technexion"

config SYS_SOC
	default "mx6"

config SYS_CONFIG_NAME
	default "tek-imx6"

endif
```

## board/technexion/tek-imx6/tnrescue.its
```
/*
 * U-Boot uImage source file with multiple kernels, ramdisks and FDT blobs
 */

/dts-v1/;

/ {
	description = "Various kernels, ramdisks and FDT blobs";
	#address-cells = <1>;

	images {
		kernel@1 {
			description = "TechNexion IMX6/IMX7 Linux Kernel";
			data = /incbin/("./zImage");
			type = "kernel";
			arch = "arm";
			os = "linux";
			compression = "none";
			load = <0x12000000>;
			entry = <0x12000000>;
			hash@2 {
				algo = "sha1";
			};
		};

		ramdisk@1 {
			description = "TechNexion Rescue/Installer Ramdisk with Qt";
			data = /incbin/("./rootfs.cpio.xz");
			type = "ramdisk";
			arch = "arm";
			os = "linux";
			compression = "none";
			hash@1 {
				algo = "sha1";
			};
		};
		/* imx6dl */
		fdt@41 {
			description = "imx6dl-tek3";
			data = /incbin/("./dtb/imx6dl-tek3.dtb");
			type = "flat_dt";
			arch = "arm";
			compression = "none";
			hash@1 {
				algo = "sha1";
			};
		};
		fdt@42 {
			description = "imx6dl-tep5_15inch";
			data = /incbin/("./dtb/imx6dl-tep5_15inch.dtb");
			type = "flat_dt";
			arch = "arm";
			compression = "none";
			hash@1 {
				algo = "sha1";
			};
		};
		fdt@43 {
			description = "imx6dl-tep5";
			data = /incbin/("./dtb/imx6dl-tep5.dtb");
			type = "flat_dt";
			arch = "arm";
			compression = "none";
			hash@1 {
				algo = "sha1";
			};
		};
		/* imx6q */
		fdt@44 {
			description = "imx6q-tek3";
			data = /incbin/("./dtb/imx6q-tek3.dtb");
			type = "flat_dt";
			arch = "arm";
			compression = "none";
			hash@1 {
				algo = "sha1";
			};
		};
		fdt@45 {
			description = "imx6q-tep5_15inch";
			data = /incbin/("./dtb/imx6q-tep5_15inch.dtb");
			type = "flat_dt";
			arch = "arm";
			compression = "none";
			hash@1 {
				algo = "sha1";
			};
		};
		fdt@46 {
			description = "imx6q-tep5";
			data = /incbin/("./dtb/imx6q-tep5.dtb");
			type = "flat_dt";
			arch = "arm";
			compression = "none";
			hash@1 {
				algo = "sha1";
			};
		};
	};

	configurations {
		/* imx6dl */
		conf@imx6dl-tek3.dtb {
			description = "TEK3-IMX6DL";
			kernel = "kernel@1";
			ramdisk = "ramdisk@1";
			fdt = "fdt@41";
		};
		conf@imx6dl-tep5_15inch.dtb {
			description = "TEP5-15INCH-IMX6DL";
			kernel = "kernel@1";
			ramdisk = "ramdisk@1";
			fdt = "fdt@42";
		};
		conf@imx6dl-tep5.dtb {
			description = "TEP5-IMX6DL";
			kernel = "kernel@1";
			ramdisk = "ramdisk@1";
			fdt = "fdt@43";
		};
		/* imx6q */
		conf@imx6q-tek3.dtb {
			description = "TEK3-IMX6Q";
			kernel = "kernel@1";
			ramdisk = "ramdisk@1";
			fdt = "fdt@44";
		};
		conf@imx6q-tep5_15inch.dtb {
			description = "TEP5-15INCH-IMX6Q";
			kernel = "kernel@1";
			ramdisk = "ramdisk@1";
			fdt = "fdt@45";
		};
		config@imx6q-tep5.dtb {
			description = "TEP5-IMX6Q";
			kernel = "kernel@1";
			ramdisk = "ramdisk@1";
			fdt = "fdt@46";
		};
	};
};
```

## board/technexion/tek-imx6ul/Kconfig
```kconfig
if TARGET_TEK_IMX6UL

config SYS_BOARD
	default "tek-imx6ul"

config SYS_VENDOR
	default "technexion"

config SYS_SOC
	default "mx6"

config SYS_CONFIG_NAME
	default "tek-imx6ul"

endif
```
