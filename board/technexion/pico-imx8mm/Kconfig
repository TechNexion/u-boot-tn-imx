## board/technexion/tek-imx6ul/tnrescue.its
```
/*
 * U-Boot uImage source file with multiple kernels, ramdisks and FDT blobs
 */

/dts-v1/;

/ {
	description = "Various kernels, ramdisks and FDT blobs";
	#address-cells = <1>;

	images {
		kernel@1 {
			description = "TechNexion IMX6/IMX7/IMX8 Linux Kernel";
			data = /incbin/("./zImage");
			type = "kernel";
			arch = "arm";
			os = "linux";
			compression = "none";
			load = <0x89F00000>;
			entry = <0x89F00000>;
			hash@2 {
				algo = "md5";
			};
		};

		ramdisk@1 {
			description = "TechNexion Rescue/Installer Ramdisk with Qt";
			data = /incbin/("./rootfs.cpio.xz");
			type = "ramdisk";
			arch = "arm";
			os = "linux";
			compression = "none";
			load = <0x8B000000>;
			entry = <0x8B000000>;
			hash@1 {
				algo = "sha1";
			};
		};
		/* imx6ul */
		fdt@1 {
			description = "imx6ul-tek3_tek3";
			data = /incbin/("./dtb/imx6ul-tek3.dtb");
			type = "flat_dt";
			arch = "arm";
			compression = "none";
			load = <0x89E00000>;
			hash@1 {
				algo = "crc32";
			};
		};
		fdt@2 {
			description = "imx6ul-tep1_tep1";
			data = /incbin/("./dtb/imx6ul-tep1.dtb");
			type = "flat_dt";
			arch = "arm";
			compression = "none";
			load = <0x89E00000>;
			hash@1 {
				algo = "crc32";
			};
		};
	};

	configurations {
		default = "config@imx6ul-tek3_tek3";
		/* imx6ul */
		config@imx6ul-tek3_tek3 {
			description = "TEK3-IMX6UL";
			kernel = "kernel@1";
			ramdisk = "ramdisk@1";
			fdt = "fdt@1";
		};
		config@imx6ul-tep1_tep1 {
			description = "TEP1-IMX6UL";
			kernel = "kernel@1";
			ramdisk = "ramdisk@1";
			fdt = "fdt@2";
		};
	};
};
```

## board/technexion/tek-imx8mp/Kconfig
```kconfig
if TARGET_TEK_IMX8MP

config SYS_BOARD
	default "tek-imx8mp"

config SYS_VENDOR
	default "technexion"

config SYS_CONFIG_NAME
	default "tek-imx8mp"

source "board/technexion/common/Kconfig"

endif
```

## board/technexion/tek3-imx6/Kconfig
```kconfig
if TARGET_TEK3_IMX6

config SYS_BOARD
	default "tek3-imx6"

config SYS_VENDOR
	string
	default "technexion"

config SYS_SOC
	default "mx6"

config SYS_CONFIG_NAME
	default "tek3-imx6"

endif
```

## board/technexion/tek3-imx6ul/Kconfig
```kconfig
if TARGET_TEK3_IMX6UL

config SYS_BOARD
	default "tek3-imx6ul"

config SYS_VENDOR
	string
	default "technexion"

config SYS_SOC
	default "mx6"

config SYS_CONFIG_NAME
	default "tek3-imx6ul"

endif
```

## board/technexion/tek3-imx8mp/Kconfig
```kconfig
if TARGET_TEK3_IMX8MP

config SYS_BOARD
	default "tek3-imx8mp"

config SYS_VENDOR
	default "technexion"

config SYS_CONFIG_NAME
	default "tek3-imx8mp"

endif
```

## board/technexion/tek5-imx6/Kconfig
```kconfig
if TARGET_TEK5_IMX6

config SYS_BOARD
	default "tek5-imx6"

config SYS_VENDOR
	string
	default "technexion"

config SYS_SOC
	default "mx6"

config SYS_CONFIG_NAME
	default "tek5-imx6"

endif
```

## board/technexion/tep-imx6ul/Kconfig
```kconfig
if TARGET_TEP_IMX6UL

config SYS_BOARD
	default "tep-imx6ul"

config SYS_VENDOR
	default "technexion"

config SYS_SOC
	default "mx6"

config SYS_CONFIG_NAME
	default "tep-imx6ul"

endif
```

## board/technexion/tep-imx8mp/Kconfig
```kconfig
if TARGET_TEP_IMX8MP

config SYS_BOARD
	default "tep-imx8mp"

config SYS_VENDOR
	default "technexion"

config SYS_CONFIG_NAME
	default "tep-imx8mp"

source "board/technexion/common/Kconfig"

endif
```

## board/technexion/tep1-imx7d/Kconfig
```kconfig
if TARGET_TEP1_IMX7D

config SYS_BOARD
	default "tep1-imx7d"

config SYS_VENDOR
	default "technexion"

config SYS_SOC
	default "mx7"

config SYS_CONFIG_NAME
	default "tep1-imx7d"

endif
```

## board/technexion/tep1-imx7d/tnrescue.its
```
/*
 * U-Boot uImage source file with multiple kernels, ramdisks and FDT blobs
 */

/dts-v1/;

/ {
	description = "Various kernels, ramdisks and FDT blobs";
	#address-cells = <1>;

	images {
		kernel@1 {
			description = "TechNexion IMX6/IMX7 Linux Kernel";
			data = /incbin/("./zImage");
			type = "kernel";
			arch = "arm";
			os = "linux";
			compression = "none";
			load = <0x80800000>;
			entry = <0x80800000>;
			hash@1 {
				algo = "md5";
			};
			hash@2 {
				algo = "sha1";
			};
		};
		ramdisk@1 {
			description = "TechNexion Installer Ramdisk with Qt";
			data = /incbin/("./rootfs.cpio.xz");
			type = "ramdisk";
			arch = "arm";
			os = "linux";
			compression = "none";
			load = <0x83800000>;
			entry = <0x83800000>;
			hash@1 {
				algo = "sha1";
			};
		};
		fdt@13 {
			description = "imx7d-tep1";
			data = /incbin/("./dtb/imx7d-tep1.dtb");
			type = "flat_dt";
			arch = "arm";
			compression = "none";
			load = <0x83000000>;
			hash@1 {
				algo = "sha1";
			};
		};
	};

	configurations {
		default = "config@imx7d-tep1_tep1";

		config@imx7d-tep1_tep1 {
			description = "TEP1-IMX7D";
			kernel = "kernel@1";
			ramdisk = "ramdisk@1";
			fdt = "fdt@13";
		};
	};
};
```

## board/technexion/tep3-imx6ul/Kconfig
```kconfig
if TARGET_TEP3_IMX6UL

config SYS_BOARD
	default "tep3-imx6ul"

config SYS_VENDOR
	string
	default "technexion"

config SYS_SOC
	default "mx6"

config SYS_CONFIG_NAME
	default "tep3-imx6ul"

endif
```

## board/technexion/xore-imx8mm/Kconfig
```kconfig
if TARGET_XORE_IMX8MM

config SYS_BOARD
	default "xore-imx8mm"

config SYS_VENDOR
	default "technexion"

config SYS_CONFIG_NAME
	default "xore-imx8mm"

endif
```

## board/technexion/xore-imx8mm/tnrescue.its
```
/*
 * U-Boot uImage source file with multiple kernels, ramdisks and FDT blobs
 */

/dts-v1/;

/ {
	description = "Various kernels, ramdisks and FDT blobs";
	#address-cells = <1>;

	images {
		kernel@1 {
			description = "Technexion IMX8mm Linux Kernel";
			data = /incbin/("./Image");
			type = "kernel";
			arch = "arm64";
			os = "linux";
			compression = "none";
			load = <0x40480000>;
			entry = <0x40480000>;
			hash@1 {
				algo = "sha1";
			};
		};

		ramdisk@1 {
			description = "Technexion Installer/Rescue Ramdisk with Qt";
			data = /incbin/("./rootfs.cpio.xz");
			type = "ramdisk";
			arch = "arm64";
			os = "linux";
			compression = "none";
			hash@1 {
				algo = "sha1";
			};
		};

		fdt@1 {
			description = "Xore imx8mm flat device tree blob for no display";
			data = /incbin/("./dtb/imx8mm-xore-wizard.dtb");
			type = "flat_dt";
			arch = "arm64";
			compression = "none";
			hash@1 {
				algo = "sha1";
			};
		};

		fdt@2 {
			description = "Xore imx8mm flat device tree blob for MIPI 5 inch panel";
			data = /incbin/("./dtb/imx8mm-xore-wizard-ili9881c.dtb");
			type = "flat_dt";
			arch = "arm64";
			compression = "none";
			hash@1 {
				algo = "sha1";
			};
		};

		fdt@3 {
			description = "Xore imx8mm flat device tree blob for MIPI 8 inch panel";
			data = /incbin/("./dtb/imx8mm-xore-wizard-g080uan01.dtb");
			type = "flat_dt";
			arch = "arm64";
			compression = "none";
			hash@1 {
				algo = "sha1";
			};
		};

		fdt@4 {
			description = "Xore imx8mm flat device tree blob for MIPI 10 inch panel";
			data = /incbin/("./dtb/imx8mm-xore-wizard-g101uan02.dtb");
			type = "flat_dt";
			arch = "arm64";
			compression = "none";
			hash@1 {
				algo = "sha1";
			};
		};

		fdt@5 {
			description = "Xore imx8mm flat device tree blob for MIPI to HDMI bridge";
			data = /incbin/("./dtb/imx8mm-xore-wizard-adv7535.dtb");
			type = "flat_dt";
			arch = "arm64";
			compression = "none";
			hash@1 {
				algo = "sha1";
			};
		};
	};

	configurations {
		conf@imx8mm-xore-wizard.dtb {
			description = "Boot IMX8mm xore wizard with no display";
			kernel = "kernel@1";
			ramdisk = "ramdisk@1";
			fdt = "fdt@1";
		};
		conf@imx8mm-xore-wizard-ili9881c.dtb {
			description = "Boot IMX8mm xore wizard with mipi 5' panel";
			kernel = "kernel@1";
			ramdisk = "ramdisk@1";
			fdt = "fdt@2";
		};
		conf@imx8mm-xore-wizard-g080uan01.dtb {
			description = "Boot IMX8mm xore wizard with MIPI 8' panel";
			kernel = "kernel@1";
			ramdisk = "ramdisk@1";
			fdt = "fdt@3";
		};
		conf@imx8mm-xore-wizard-g101uan02.dtb {
			description = "Boot IMX8mm xore wizard with MIPI 10' panel";
			kernel = "kernel@1";
			ramdisk = "ramdisk@1";
			fdt = "fdt@4";
		};
		conf@imx8mm-xore-wizard-adv7535.dtb {
			description = "Boot IMX8mm xore with MIPI to HDMI bridge";
			kernel = "kernel@1";
			ramdisk = "ramdisk@1";
			fdt = "fdt@5";
		};
	};
};
```

## configs/edm-cf-imx6-no-console_defconfig
```kconfig
CONFIG_SPL=y
CONFIG_SYS_EXTRA_OPTIONS="IMX_CONFIG=arch/arm/imx-common/spl_sd.cfg,MX6QDL,NO_DEBUG_CONSOLE"
CONFIG_ARM=y
CONFIG_TARGET_EDM_CF_IMX6=y
CONFIG_DM=y
CONFIG_DM_THERMAL=y
```

## configs/edm-imx6_android_spl_defconfig
```kconfig
CONFIG_ARM=y
CONFIG_ARCH_MX6=y
CONFIG_SYS_TEXT_BASE=0x17800000
CONFIG_SPL_GPIO_SUPPORT=y
CONFIG_SPL_LIBCOMMON_SUPPORT=y
CONFIG_SPL_LIBGENERIC_SUPPORT=y
CONFIG_TARGET_EDM_IMX6=y
CONFIG_SPL_MMC_SUPPORT=y
CONFIG_SPL_SERIAL_SUPPORT=y
CONFIG_SPL_LIBDISK_SUPPORT=y
CONFIG_SPL_WATCHDOG_SUPPORT=y
CONFIG_FIT=y
CONFIG_FIT_VERBOSE=y
CONFIG_SYS_EXTRA_OPTIONS="IMX_CONFIG=arch/arm/mach-imx/spl_sd.cfg,MX6QDL,ANDROID_SUPPORT"
CONFIG_BOOTDELAY=1
# CONFIG_CONSOLE_MUX is not set
CONFIG_SYS_CONSOLE_IS_IN_ENV=y
CONFIG_SYS_CONSOLE_OVERWRITE_ROUTINE=y
CONFIG_SPL=y
CONFIG_SPL_RAW_IMAGE_SUPPORT=y
CONFIG_SYS_MMCSD_RAW_MODE_U_BOOT_SECTOR=0x5c
CONFIG_SPL_I2C_SUPPORT=y
CONFIG_HUSH_PARSER=y
CONFIG_CMD_BOOTZ=y
# CONFIG_CMD_FLASH is not set
CONFIG_CMD_GPIO=y
CONFIG_CMD_GPT=y
# CONFIG_RANDOM_UUID is not set
CONFIG_CMD_GPT_RENAME=y
CONFIG_CMD_I2C=y
CONFIG_CMD_MMC=y
CONFIG_CMD_USB=y
CONFIG_CMD_CACHE=y
CONFIG_CMD_EXT2=y
CONFIG_CMD_EXT4=y
CONFIG_CMD_EXT4_WRITE=y
CONFIG_CMD_FAT=y
CONFIG_CMD_FS_GENERIC=y
# CONFIG_SPL_EFI_PARTITION is not set
CONFIG_MXC_UART=y
CONFIG_IMX_THERMAL=y
CONFIG_USB=y
CONFIG_MXC_USB_OTG_HACTIVE=y
CONFIG_VIDEO=y
# CONFIG_VIDEO_SW_CURSOR is not set
CONFIG_OF_LIBFDT=y
```

## configs/edm-imx6_spl_defconfig
```kconfig
CONFIG_ARM=y
CONFIG_ARCH_MX6=y
CONFIG_SPL_LDSCRIPT="arch/$(ARCH)/cpu/u-boot-spl.lds"
CONFIG_SYS_TEXT_BASE=0x17800000
CONFIG_SPL_GPIO_SUPPORT=y
CONFIG_SPL_LIBCOMMON_SUPPORT=y
CONFIG_SPL_LIBGENERIC_SUPPORT=y
CONFIG_NR_DRAM_BANKS=1
CONFIG_ENV_SIZE=0x2000
CONFIG_ENV_OFFSET=0x60000
CONFIG_MX6QDL=y
CONFIG_TARGET_EDM_IMX6=y
CONFIG_DM_GPIO=y
CONFIG_SPL_TEXT_BASE=0x00908800
CONFIG_SPL_MMC_SUPPORT=y
CONFIG_SPL_SERIAL_SUPPORT=y
CONFIG_SPL=y
CONFIG_SPL_FS_FAT=y
CONFIG_SPL_LIBDISK_SUPPORT=y
CONFIG_DEFAULT_DEVICE_TREE="imx6dl-edm"
# CONFIG_ANDROID_BOOT_IMAGE is not set
CONFIG_FIT=y
CONFIG_SPL_FIT_PRINT=y
CONFIG_SPL_LOAD_FIT=y
# CONFIG_USE_SPL_FIT_GENERATOR is not set
CONFIG_OF_BOARD_SETUP=y
CONFIG_SYS_EXTRA_OPTIONS="IMX_CONFIG=arch/arm/mach-imx/spl_sd.cfg"
CONFIG_DEFAULT_FDT_FILE="ask"
CONFIG_SYS_CONSOLE_OVERWRITE_ROUTINE=y
CONFIG_SPL_RAW_IMAGE_SUPPORT=y
# CONFIG_SYS_MMCSD_RAW_MODE_U_BOOT_USE_SECTOR is not set
CONFIG_SPL_I2C_SUPPORT=y
CONFIG_SPL_USB_HOST_SUPPORT=y
CONFIG_SPL_USB_GADGET=y
CONFIG_SPL_USB_SDP_SUPPORT=y
CONFIG_SPL_WATCHDOG_SUPPORT=y
CONFIG_HUSH_PARSER=y
CONFIG_CMD_BOOTZ=y
CONFIG_CMD_BOOTMENU=y
CONFIG_CMD_SPL=y
CONFIG_CMD_SPL_WRITE_SIZE=0x20000
CONFIG_CMD_DFU=y
CONFIG_CMD_GPIO=y
CONFIG_CMD_I2C=y
CONFIG_CMD_MMC=y
CONFIG_CMD_PART=y
CONFIG_CMD_USB=y
CONFIG_CMD_USB_SDP=y
CONFIG_CMD_USB_MASS_STORAGE=y
CONFIG_CMD_DHCP=y
CONFIG_CMD_MII=y
CONFIG_CMD_PING=y
CONFIG_CMD_BMP=y
CONFIG_CMD_CACHE=y
CONFIG_CMD_SYSBOOT=y
CONFIG_CMD_EXT2=y
CONFIG_CMD_EXT4=y
CONFIG_CMD_EXT4_WRITE=y
CONFIG_CMD_FAT=y
CONFIG_CMD_FS_GENERIC=y
# CONFIG_SPL_EFI_PARTITION is not set
CONFIG_OF_CONTROL=y
CONFIG_OF_LIST="imx6dl-edm imx6q-edm imx6qp-edm"
CONFIG_MULTI_DTB_FIT=y
CONFIG_ENV_IS_IN_MMC=y
CONFIG_SYS_RELOC_GD_ENV_ADDR=y
CONFIG_SYS_MMC_ENV_DEV=2
CONFIG_ENV_VARS_UBOOT_RUNTIME_CONFIG=y
CONFIG_BOUNCE_BUFFER=y
CONFIG_DFU_MMC=y
CONFIG_USB_FUNCTION_FASTBOOT=y
CONFIG_FASTBOOT_BUF_ADDR=0x12000000
CONFIG_FASTBOOT_BUF_SIZE=0x10000000
CONFIG_FASTBOOT_FLASH=y
CONFIG_DM_MMC=y
CONFIG_FSL_USDHC=y
CONFIG_DM_ETH=y
CONFIG_PINCTRL=y
CONFIG_PINCTRL_IMX6=y
CONFIG_DM_REGULATOR=y
CONFIG_DM_REGULATOR_FIXED=y
CONFIG_MXC_UART=y
CONFIG_IMX_THERMAL=y
CONFIG_USB=y
CONFIG_DM_USB=y
CONFIG_MXC_USB_OTG_HACTIVE=y
CONFIG_USB_GADGET=y
CONFIG_USB_GADGET_MANUFACTURER="FSL"
CONFIG_USB_GADGET_VENDOR_NUM=0x0525
CONFIG_USB_GADGET_PRODUCT_NUM=0xa4a5
CONFIG_CI_UDC=y
CONFIG_SDP_LOADADDR=0x17800000
CONFIG_DM_VIDEO=y
CONFIG_VIDEO_LOGO=y
CONFIG_SYS_WHITE_ON_BLACK=y
CONFIG_I2C_EDID=y
CONFIG_VIDEO_IPUV3=y
CONFIG_SPLASH_SCREEN=y
CONFIG_SPLASH_SCREEN_ALIGN=y
CONFIG_SPLASH_SOURCE=y
CONFIG_BMP_16BPP=y
CONFIG_VIDEO_LINK=y
```
