## board/technexion/flex-imx8mm/tnrescue.its
```
/*
 * U-Boot uImage source file with multiple kernels, ramdisks and FDT blobs
 */

/dts-v1/;

/ {
	description = "Various kernels, ramdisks and FDT blobs";
	#address-cells = <1>;

	images {
		kernel@1 {
			description = "Technexion IMX8 Linux Kernel";
			data = /incbin/("./Image");
			type = "kernel";
			arch = "arm64";
			os = "linux";
			compression = "none";
			load = <0x40480000>;
			entry = <0x40480000>;
			hash@1 {
				algo = "sha1";
			};
		};

		ramdisk@1 {
			description = "Technexion Installer/Rescue Ramdisk with Qt";
			data = /incbin/("./rootfs.cpio.xz");
			type = "ramdisk";
			arch = "arm64";
			os = "linux";
			compression = "none";
			load = <0x43800000>;
			entry = <0x43800000>;
			hash@1 {
				algo = "sha1";
			};
		};

		fdt@1 {
			description = "Flex imx8mm flat device tree blob for no display";
			data = /incbin/("./dtb/imx8mm-flex-pi.dtb");
			type = "flat_dt";
			arch = "arm64";
			compression = "none";
			load = <0x43000000>;
			hash@1 {
				algo = "sha1";
			};
		};

		fdt@2 {
			description = "Flex imx8mm wizard flat device tree blob for no display";
			data = /incbin/("./dtb/imx8mm-flex-wizard.dtb");
			type = "flat_dt";
			arch = "arm64";
			compression = "none";
			load = <0x43000000>;
			hash@1 {
				algo = "sha1";
			};
		};

		fdt@3 {
			description = "Flex imx8mm pi flat device tree blob for MIPI 5 inch panel";
			data = /incbin/("./dtb/imx8mm-flex-pi-ili9881c.dtb");
			type = "flat_dt";
			arch = "arm64";
			compression = "none";
			load = <0x43000000>;
			hash@1 {
				algo = "sha1";
			};
		};

		fdt@4 {
			description = "pi mipi 5' panel overlay";
			data = /incbin/("./dtb/imx8mm-flex-pi-mipi5.dtbo");
			type = "flat_dt";
			arch = "arm64";
			compression = "none";
			load = <0x43100000>;
			hash@1 {
				algo = "sha1";
			};
		};

		fdt@5 {
			description = "wizard mipi 5' panel overlay";
			data = /incbin/("./dtb/imx8mm-flex-wizard-mipi5.dtbo");
			type = "flat_dt";
			arch = "arm64";
			compression = "none";
			load = <0x43110000>;
			hash@1 {
				algo = "sha1";
			};
		};

		fdt@6 {
			description = "wizard mipi 8' panel overlay";
			data = /incbin/("./dtb/imx8mm-flex-wizard-mipi8.dtbo");
			type = "flat_dt";
			arch = "arm64";
			compression = "none";
			load = <0x43120000>;
			hash@1 {
				algo = "sha1";
			};
		};

		fdt@7 {
			description = "wizard mipi 10' panel overlay";
			data = /incbin/("./dtb/imx8mm-flex-wizard-mipi10.dtbo");
			type = "flat_dt";
			arch = "arm64";
			compression = "none";
			load = <0x43130000>;
			hash@1 {
				algo = "sha1";
			};
		};

		fdt@8 {
			description = "wizard mipi to hdmi bridge overlay";
			data = /incbin/("./dtb/imx8mm-flex-wizard-mipi2hdmi.dtbo");
			type = "flat_dt";
			arch = "arm64";
			compression = "none";
			load = <0x43140000>;
			hash@1 {
				algo = "sha1";
			};
		};

		fdt@9 {
			description = "wizard lvds 10' panel overlay";
			data = /incbin/("./dtb/imx8mm-flex-wizard-lvds10.dtbo");
			type = "flat_dt";
			arch = "arm64";
			compression = "none";
			load = <0x43150000>;
			hash@1 {
				algo = "sha1";
			};
		};
	};

	configurations {
		imx8mm-flex-pi.dtb {
			description = "Boot IMX8mm pi with no display";
			kernel = "kernel@1";
			ramdisk = "ramdisk@1";
			fdt = "fdt@1";
		};
		imx8mm-flex-wizard.dtb {
			description = "Boot IMX8mm wizard with no display";
			kernel = "kernel@1";
			ramdisk = "ramdisk@1";
			fdt = "fdt@2";
		};
		imx8mm-flex-pi-ili9881c.dtb {
			description = "Boot IMX8mm with MIPI 5' panel";
			kernel = "kernel@1";
			ramdisk = "ramdisk@1";
			fdt = "fdt@3";
		};
		imx8mm-flex-pi-mipi5.dtb {
			description = "Flex IMX8M PI with MIPI 5' overlay";
			kernel = "kernel@1";
			ramdisk = "ramdisk@1";
			fdt = "fdt@1", "fdt@4";
		};
		mipi5 {
			description = "WIZARD MIPI 5' overlay";
			fdt = "fdt@5";
		};
		mipi8 {
			description = "WIZARD MIPI 8' overlay";
			fdt = "fdt@6";
		};
		mipi10 {
			description = "WIZARD MIPI 10' overlay";
			fdt = "fdt@7";
		};
		mipi2hdmi {
			description = "WIZARD MIPI to HDMI bridge overlay";
			fdt = "fdt@8";
		};
		lvds10 {
			description = "WIZARD MIPI to HDMI bridge overlay";
			fdt = "fdt@9";
		};
	};
};
```

## board/technexion/hmi-imx8mp/Kconfig
```kconfig
if TARGET_HMI_IMX8MP

config SYS_BOARD
	default "hmi-imx8mp"

config SYS_VENDOR
	default "technexion"

config SYS_CONFIG_NAME
	default "hmi-imx8mp"

source "board/technexion/common/Kconfig"

endif
```

## board/technexion/pico-imx6/tnrescue.its
```
/*
 * U-Boot uImage source file with multiple kernels, ramdisks and FDT blobs
 */

/dts-v1/;

/ {
	description = "Various kernels, ramdisks and FDT blobs";
	#address-cells = <1>;

	images {
		kernel@1 {
			description = "TechNexion IMX6/IMX7 Linux Kernel";
			data = /incbin/("./zImage");
			type = "kernel";
			arch = "arm";
			os = "linux";
			compression = "none";
			load = <0x12000000>;
			entry = <0x12000000>;
			hash@1 {
				algo = "sha1";
			};
		};

		ramdisk@1 {
			description = "TechNexion Rescue/Installer Ramdisk with Qt";
			data = /incbin/("./rootfs.cpio.xz");
			type = "ramdisk";
			arch = "arm";
			os = "linux";
			compression = "none";
			load = <0x18100000>;
			entry = <0x18100000>;
			hash@1 {
				algo = "sha1";
			};
		};
		/* imx6dl */
		fdt@1 {
			description = "imx6dl pico dwarf";
			data = /incbin/("./dtb/imx6dl-pico-dwarf.dtb");
			type = "flat_dt";
			arch = "arm";
			compression = "none";
			load = <0x18000000>;
			hash@1 {
				algo = "sha1";
			};
		};
		fdt@2 {
			description = "imx6dl pico hobbit";
			data = /incbin/("./dtb/imx6dl-pico-hobbit.dtb");
			type = "flat_dt";
			arch = "arm";
			compression = "none";
			load = <0x18000000>;
			hash@1 {
				algo = "sha1";
			};
		};
		fdt@3 {
			description = "imx6dl pico nymph";
			data = /incbin/("./dtb/imx6dl-pico-nymph.dtb");
			type = "flat_dt";
			arch = "arm";
			compression = "none";
			load = <0x18000000>;
			hash@1 {
				algo = "sha1";
			};
		};
		fdt@4 {
			description = "imx6dl pico pi";
			data = /incbin/("./dtb/imx6dl-pico-pi.dtb");
			type = "flat_dt";
			arch = "arm";
			compression = "none";
			load = <0x18000000>;
			hash@1 {
				algo = "sha1";
			};
		};
		/* imx6q */
		fdt@9 {
			description = "imx6q pico dwarf";
			data = /incbin/("./dtb/imx6q-pico-dwarf.dtb");
			type = "flat_dt";
			arch = "arm";
			compression = "none";
			load = <0x18000000>;
			hash@1 {
				algo = "sha1";
			};
		};
		fdt@10 {
			description = "imx6q pico hobbit";
			data = /incbin/("./dtb/imx6q-pico-hobbit.dtb");
			type = "flat_dt";
			arch = "arm";
			compression = "none";
			load = <0x18000000>;
			hash@1 {
				algo = "sha1";
			};
		};
		fdt@11 {
			description = "imx6q pico nymph";
			data = /incbin/("./dtb/imx6q-pico-nymph.dtb");
			type = "flat_dt";
			arch = "arm";
			compression = "none";
			load = <0x18000000>;
			hash@1 {
				algo = "sha1";
			};
		};
		fdt@12 {
			description = "imx6q pico pi";
			data = /incbin/("./dtb/imx6q-pico-pi.dtb");
			type = "flat_dt";
			arch = "arm";
			compression = "none";
			load = <0x18000000>;
			hash@1 {
				algo = "sha1";
			};
		};
	};

	configurations {
		/* imx6dl */
		imx6dl-pico-dwarf.dtb {
			description = "PICO-DWARF-IMX6DL";
			kernel = "kernel@1";
			ramdisk = "ramdisk@1";
			fdt = "fdt@1";
		};
		imx6dl-pico-hobbit.dtb {
			description = "PICO-HOBBIT-IMX6DL";
			kernel = "kernel@1";
			ramdisk = "ramdisk@1";
			fdt = "fdt@2";
		};
		imx6dl-pico-nymph.dtb {
			description = "PICO-NYMPH-IMX6DL";
			kernel = "kernel@1";
			ramdisk = "ramdisk@1";
			fdt = "fdt@3";
		};
		imx6dl-pico-pi.dtb {
			description = "PICO-PI-IMX6DL";
			kernel = "kernel@1";
			ramdisk = "ramdisk@1";
			fdt = "fdt@4";
		};
		imx6dl-pico-dwarf-qca.dtb {
			description = "PICO-DWARF-IMX6DL";
			kernel = "kernel@1";
			ramdisk = "ramdisk@1";
			fdt = "fdt@1";
		};
		imx6dl-pico-hobbit-qca.dtb {
			description = "PICO-HOBBIT-IMX6DL";
			kernel = "kernel@1";
			ramdisk = "ramdisk@1";
			fdt = "fdt@2";
		};
		imx6dl-pico-nymph-qca.dtb {
			description = "PICO-NYMPH-IMX6DL";
			kernel = "kernel@1";
			ramdisk = "ramdisk@1";
			fdt = "fdt@3";
		};
		imx6dl-pico-pi-qca.dtb {
			description = "PICO-PI-IMX6DL";
			kernel = "kernel@1";
			ramdisk = "ramdisk@1";
			fdt = "fdt@4";
		};
		/* imx6q */
		imx6q-pico-dwarf.dtb {
			description = "PICO-DWARF-IMX6Q";
			kernel = "kernel@1";
			ramdisk = "ramdisk@1";
			fdt = "fdt@9";
		};
		imx6q-pico-hobbit.dtb {
			description = "PICO-HOBBIT-IMX6Q";
			kernel = "kernel@1";
			ramdisk = "ramdisk@1";
			fdt = "fdt@10";
		};
		imx6q-pico-nymph.dtb {
			description = "PICO-NYMPH-IMX6Q";
			kernel = "kernel@1";
			ramdisk = "ramdisk@1";
			fdt = "fdt@11";
		};
		imx6q-pico-pi.dtb {
			description = "PICO-PI-IMX6Q";
			kernel = "kernel@1";
			ramdisk = "ramdisk@1";
			fdt = "fdt@12";
		};
		imx6q-pico-dwarf-qca.dtb {
			description = "PICO-DWARF-IMX6Q";
			kernel = "kernel@1";
			ramdisk = "ramdisk@1";
			fdt = "fdt@9";
		};
		imx6q-pico-hobbit-qca.dtb {
			description = "PICO-HOBBIT-IMX6Q";
			kernel = "kernel@1";
			ramdisk = "ramdisk@1";
			fdt = "fdt@10";
		};
		imx6q-pico-nymph-qca.dtb {
			description = "PICO-NYMPH-IMX6Q";
			kernel = "kernel@1";
			ramdisk = "ramdisk@1";
			fdt = "fdt@11";
		};
		imx6q-pico-pi-qca.dtb {
			description = "PICO-PI-IMX6Q";
			kernel = "kernel@1";
			ramdisk = "ramdisk@1";
			fdt = "fdt@12";
		};
	};
};
```

## board/technexion/pico-imx6ul-nand/Kconfig
```kconfig
if TARGET_PICO_IMX6UL_NAND

config SYS_BOARD
	default "pico-imx6ul-nand"

config SYS_VENDOR
	default "technexion"

config SYS_SOC
	default "mx6"

config SYS_CONFIG_NAME
	default "pico-imx6ul-nand"

endif
```

## board/technexion/pico-imx7d/tnrescue.its
```
/*
 * U-Boot uImage source file with multiple kernels, ramdisks and FDT blobs
 */

/dts-v1/;

/ {
	description = "Various kernels, ramdisks and FDT blobs";
	#address-cells = <1>;

	images {
		kernel@1 {
			description = "TechNexion IMX6/IMX7 Linux Kernel";
			data = /incbin/("./zImage");
			type = "kernel";
			arch = "arm";
			os = "linux";
			compression = "none";
			load = <0x80800000>;
			entry = <0x80800000>;
			hash@1 {
				algo = "sha1";
			};
		};
		ramdisk@1 {
			description = "TechNexion Installer Ramdisk with Qt";
			data = /incbin/("./rootfs.cpio.xz");
			type = "ramdisk";
			arch = "arm";
			os = "linux";
			compression = "none";
			load = <0x83800000>;
			entry = <0x83800000>;
			hash@1 {
				algo = "sha1";
			};
		};
		fdt@1 {
			description = "imx7d-pico + dwarf board";
			data = /incbin/("./dtb/imx7d-pico-dwarf.dtb");
			type = "flat_dt";
			arch = "arm";
			compression = "none";
			load = <0x83000000>;
			hash@1 {
				algo = "sha1";
			};
		};
		fdt@2 {
			description = "imx7d-pico + hobbit board";
			data = /incbin/("./dtb/imx7d-pico-hobbit.dtb");
			type = "flat_dt";
			arch = "arm";
			compression = "none";
			load = <0x83000000>;
			hash@1 {
				algo = "sha1";
			};
		};
		fdt@3 {
			description = "imx7d-pico + nymph board";
			data = /incbin/("./dtb/imx7d-pico-nymph.dtb");
			type = "flat_dt";
			arch = "arm";
			compression = "none";
			load = <0x83000000>;
			hash@1 {
				algo = "sha1";
			};
		};
		fdt@4 {

			description = "imx7d-pico + pi board";
			data = /incbin/("./dtb/imx7d-pico-pi.dtb");
			type = "flat_dt";
			arch = "arm";
			compression = "none";
			load = <0x83000000>;
			hash@1 {
				algo = "sha1";
			};
		};
	};

	configurations {
		imx7d-pico-dwarf.dtb {
			description = "PICO-DWARF-IMX7D";
			kernel = "kernel@1";
			ramdisk = "ramdisk@1";
			fdt = "fdt@1";
		};
		imx7d-pico-hobbit.dtb {
			description = "PICO-HOBBIT-IMX7D";
			kernel = "kernel@1";
			ramdisk = "ramdisk@1";
			fdt = "fdt@2";
		};
		imx7d-pico-nymph.dtb {
			description = "PICO-NYMPH-IMX7D";
			kernel = "kernel@1";
			ramdisk = "ramdisk@1";
			fdt = "fdt@3";
		};
		imx7d-pico-pi.dtb {
			description = "PICO-PI-IMX7D";
			kernel = "kernel@1";
			ramdisk = "ramdisk@1";
			fdt = "fdt@4";
		};
		imx7d-pico-dwarf-qca.dtb {
			description = "PICO-QCA-DWARF-IMX7D";
			kernel = "kernel@1";
			ramdisk = "ramdisk@1";
			fdt = "fdt@1";
		};
		imx7d-pico-hobbit-qca.dtb {
			description = "PICO-QCA-HOBBIT-IMX7D";
			kernel = "kernel@1";
			ramdisk = "ramdisk@1";
			fdt = "fdt@2";
		};
		imx7d-pico-nymph-qca.dtb {
			description = "PICO-QCA-NYMPH-IMX7D";
			kernel = "kernel@1";
			ramdisk = "ramdisk@1";
			fdt = "fdt@3";
		};
		imx7d-pico-pi-qca.dtb {
			description = "PICO-QCA-PI-IMX7D";
			kernel = "kernel@1";
			ramdisk = "ramdisk@1";
			fdt = "fdt@4";
		};
	};
};
```

## board/technexion/pico-imx8m/Kconfig
```kconfig
if TARGET_PICO_IMX8M

config SYS_BOARD
	default "pico-imx8m"

config SYS_VENDOR
	default "technexion"

config SYS_CONFIG_NAME
	default "pico-imx8m"

endif
```

## board/technexion/pico-imx8m/tnrescue.its
```
/*
 * U-Boot uImage source file with multiple kernels, ramdisks and FDT blobs
 */

/dts-v1/;

/ {
	description = "Various kernels, ramdisks and FDT blobs";
	#address-cells = <1>;

	images {
		kernel@1 {
			description = "Technexion IMX8mq Linux Kernel";
			data = /incbin/("./Image");
			type = "kernel";
			arch = "arm64";
			os = "linux";
			compression = "none";
			load = <0x40480000>;
			entry = <0x40480000>;
			hash@1 {
				algo = "md5";
			};
			hash@2 {
				algo = "sha1";
			};
		};

		ramdisk@1 {
			description = "Technexion Installer Ramdisk with Qt";
			data = /incbin/("./rootfs.cpio.xz");
			type = "ramdisk";
			arch = "arm64";
			os = "linux";
			compression = "none";
			load = <0x41480000>;
			entry = <0x41480000>;
			hash@1 {
				algo = "sha1";
			};
		};

		fdt@1 {
			description = "Pico imx8m flat device tree blob for HDMI";
			data = /incbin/("./dtb/pico-imx8m.dtb");
			type = "flat_dt";
			arch = "arm64";
			compression = "none";
			load = <0x40460000>;
			hash@1 {
				algo = "crc32";
			};
			hash@2 {
				algo = "sha1";
			};
		};

		fdt@2 {
			description = "Pico imx8m flat device tree blob for MIPI DSI";
			data = /incbin/("./dtb/pico-imx8m-dcss-ili9881c.dtb");
			type = "flat_dt";
			arch = "arm64";
			compression = "none";
			load = <0x40460000>;
			hash@1 {
				algo = "crc32";
			};
			hash@2 {
				algo = "sha1";
			};
		};
	};

	configurations {
		default = "config@imx8mq_pi_hdmi";

		config@imx8mq_pi_hdmi {
			description = "Boot IMX8mq with HDMI";
			kernel = "kernel@1";
			ramdisk = "ramdisk@1";
			fdt = "fdt@1";
		};

		config@imx8mq_pi {
			description = "Boot IMX8mq with MIPI DSI";
			kernel = "kernel@1";
			ramdisk = "ramdisk@1";
			fdt = "fdt@2";
		};
	};
};
```
