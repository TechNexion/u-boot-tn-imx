## board/technexion/axon-imx6/Kconfig
```kconfig
if TARGET_AXON_IMX6

config SYS_CPU
	default "armv7"

config SYS_BOARD
	default "axon-imx6"

config SYS_VENDOR
	default "technexion"

config SYS_SOC
	default "mx6"

config SYS_CONFIG_NAME
	default "axon-imx6"

endif
```

## board/technexion/axon-imx8mm/Kconfig
```kconfig
if TARGET_AXON_IMX8MM

config SYS_BOARD
	default "axon-imx8mm"

config SYS_VENDOR
	default "technexion"

config SYS_CONFIG_NAME
	default "axon-imx8mm"

endif
```

## board/technexion/axon-imx8mp/Kconfig
```kconfig
if TARGET_AXON_IMX8MP

config SYS_BOARD
	default "axon-imx8mp"

config SYS_VENDOR
	default "technexion"

config SYS_CONFIG_NAME
	default "axon-imx8mp"

source "board/technexion/common/Kconfig"

endif
```

## board/technexion/axon-imx93/Kconfig
```kconfig
if TARGET_AXON_IMX93

config SYS_BOARD
	default "axon-imx93"

config SYS_VENDOR
	default "technexion"

config SYS_CONFIG_NAME
	default "axon-imx93"

config AXON_IMX93_LPDDR4X
	bool "Using LPDDR4X Timing and PMIC voltage"
	select IMX9_LPDDR4X
	help
	  Select the LPDDR4X timing and 0.6V VDDQ

source "board/technexion/common/Kconfig"

endif
```

## board/technexion/common/Kconfig
```kconfig
config TN_PHERIPHERAL_DETECT
	bool "Support for panel/camera/gadget detection for TechNexion board"
	help
	   Support for panel/camera/gadget detection for TechNexion board
```

## board/technexion/edm-cf-imx6/Kconfig
```kconfig
if TARGET_EDM_CF_IMX6

config SYS_BOARD
	default "edm-cf-imx6"

config SYS_VENDOR
	string
	default "technexion"

config SYS_SOC
	default "mx6"

config SYS_CONFIG_NAME
	default "edm-cf-imx6"

endif
```

## board/technexion/edm-g-imx8mm/Kconfig
```kconfig
if TARGET_EDM_G_IMX8MM

config SYS_BOARD
	default "edm-g-imx8mm"

config SYS_VENDOR
	default "technexion"

config SYS_CONFIG_NAME
	default "edm-g-imx8mm"

source "board/technexion/common/Kconfig"

endif
```

## board/technexion/edm-g-imx8mn/Kconfig
```kconfig
if TARGET_EDM_G_IMX8MN

config SYS_BOARD
	default "edm-g-imx8mn"

config SYS_VENDOR
	default "technexion"

config SYS_CONFIG_NAME
	default "edm-g-imx8mn"

config IMX8MN_LOW_DRIVE_MODE
	bool "Enable the low drive mode of iMX8MN"
	default n

source "board/technexion/common/Kconfig"

endif
```

## board/technexion/edm-g-imx8mp/Kconfig
```kconfig
if TARGET_EDM_G_IMX8MP

config SYS_BOARD
	default "edm-g-imx8mp"

config SYS_VENDOR
	default "technexion"

config SYS_CONFIG_NAME
	default "edm-g-imx8mp"

source "board/technexion/common/Kconfig"

endif
```

## board/technexion/edm-imx6/Kconfig
```kconfig
if TARGET_EDM_IMX6

config SYS_BOARD
	default "edm-imx6"

config SYS_VENDOR
	default "technexion"

config SYS_SOC
	default "mx6"

config SYS_CONFIG_NAME
	default "edm-imx6"

endif
```

## board/technexion/edm-imx6/tnrescue.its
```
/*
 * U-Boot uImage source file with multiple kernels, ramdisks and FDT blobs
 */

/dts-v1/;

/ {
	description = "Various kernels, ramdisks and FDT blobs";
	#address-cells = <1>;

	images {
		kernel@1 {
			description = "TechNexion IMX6/IMX7 Linux Kernel";
			data = /incbin/("./zImage");
			type = "kernel";
			arch = "arm";
			os = "linux";
			compression = "none";
			load = <0x12000000>;
			entry = <0x12000000>;
			hash@2 {
				algo = "sha1";
			};
		};

		ramdisk@1 {
			description = "TechNexion Rescue/Installer Ramdisk with Qt";
			data = /incbin/("./rootfs.cpio.xz");
			type = "ramdisk";
			arch = "arm";
			os = "linux";
			compression = "none";
			load = <0x18100000>;
			entry = <0x18100000>;
			hash@1 {
				algo = "sha1";
			};
		};
		/* fairy */
		fdt@11 {
			description = "imx6dl edm1 fairy qca";
			data = /incbin/("./dtb/imx6dl-edm1-fairy-qca.dtb");
			type = "flat_dt";
			arch = "arm";
			compression = "none";
			load = <0x18000000>;
			hash@1 {
				algo = "sha1";
			};
		};
		fdt@21 {
			description = "imx6q edm1 fairy qca";
			data = /incbin/("./dtb/imx6q-edm1-fairy-qca.dtb");
			type = "flat_dt";
			arch = "arm";
			compression = "none";
			load = <0x18000000>;
			hash@1 {
				algo = "sha1";
			};
		};
		fdt@31 {
			description = "imx6qp edm1 fairy qca";
			data = /incbin/("./dtb/imx6qp-edm1-fairy-qca.dtb");
			type = "flat_dt";
			arch = "arm";
			compression = "none";
			load = <0x18000000>;
			hash@1 {
				algo = "sha1";
			};
		};
		/* gnome */
		fdt@12 {
			description = "imx6dl edm1 gnome qca";
			data = /incbin/("./dtb/imx6dl-edm1-gnome-qca.dtb");
			type = "flat_dt";
			arch = "arm";
			compression = "none";
			load = <0x18000000>;
			hash@1 {
				algo = "sha1";
			};
		};
		fdt@22 {
			description = "imx6q edm1 gnome qca";
			data = /incbin/("./dtb/imx6q-edm1-gnome-qca.dtb");
			type = "flat_dt";
			arch = "arm";
			compression = "none";
			load = <0x18000000>;
			hash@1 {
				algo = "sha1";
			};
		};
		fdt@32 {
			description = "imx6qp edm1 gnome qca";
			data = /incbin/("./dtb/imx6qp-edm1-gnome-qca.dtb");
			type = "flat_dt";
			arch = "arm";
			compression = "none";
			load = <0x18000000>;
			hash@1 {
				algo = "sha1";
			};
		};
		/* tc0700 */
		fdt@13 {
			description = "imx6dl edm1 tc0700 qca";
			data = /incbin/("./dtb/imx6dl-edm1-tc0700-qca.dtb");
			type = "flat_dt";
			arch = "arm";
			compression = "none";
			load = <0x18000000>;
			hash@1 {
				algo = "sha1";
			};
		};
		fdt@23 {
			description = "imx6q edm1 tc0700 qca";
			data = /incbin/("./dtb/imx6q-edm1-tc0700-qca.dtb");
			type = "flat_dt";
			arch = "arm";
			compression = "none";
			load = <0x18000000>;
			hash@1 {
				algo = "sha1";
			};
		};
		fdt@33 {
			description = "imx6qp edm1 tc0700 qca";
			data = /incbin/("./dtb/imx6qp-edm1-tc0700-qca.dtb");
			type = "flat_dt";
			arch = "arm";
			compression = "none";
			load = <0x18000000>;
			hash@1 {
				algo = "sha1";
			};
		};
		/* tc1000 */
		fdt@14 {
			description = "imx6dl edm1 tc1000 qca";
			data = /incbin/("./dtb/imx6dl-edm1-tc1000-qca.dtb");
			type = "flat_dt";
			arch = "arm";
			compression = "none";
			load = <0x18000000>;
			hash@1 {
				algo = "sha1";
			};
		};
		fdt@24 {
			description = "imx6q edm1 tc1000 qca";
			data = /incbin/("./dtb/imx6q-edm1-tc1000-qca.dtb");
			type = "flat_dt";
			arch = "arm";
			compression = "none";
			load = <0x18000000>;
			hash@1 {
				algo = "sha1";
			};
		};
		fdt@34 {
			description = "imx6qp edm1 tc1000 qca";
			data = /incbin/("./dtb/imx6qp-edm1-tc1000-qca.dtb");
			type = "flat_dt";
			arch = "arm";
			compression = "none";
			load = <0x18000000>;
			hash@1 {
				algo = "sha1";
			};
		};
	};

	configurations {
		/* imx6dl */
		config@imx6dl-edm1-fairy-qca {
			description = "IMX6DL EDM1 FAIRY QCA";
			kernel = "kernel@1";
			ramdisk = "ramdisk@1";
			fdt = "fdt@11";
		};
		config@imx6dl-edm1-gnome-qca {
			description = "IMX6DL EDM1 GNOME QCA";
			kernel = "kernel@1";
			ramdisk = "ramdisk@1";
			fdt = "fdt@12";
		};
		config@imx6dl-edm1-tc0700-qca {
			description = "IMX6DL EDM1 TC0700 QCA";
			kernel = "kernel@1";
			ramdisk = "ramdisk@1";
			fdt = "fdt@13";
		};
		config@imx6dl-edm1-tc1000-qca {
			description = "IMX6DL EDM1 TC1000 QCA";
			kernel = "kernel@1";
			ramdisk = "ramdisk@1";
			fdt = "fdt@14";
		};
		/* imx6q */
		config@imx6q-edm1-fairy-qca {
			description = "IMX6Q EDM1 FAIRY QCA";
			kernel = "kernel@1";
			ramdisk = "ramdisk@1";
			fdt = "fdt@21";
		};
		config@imx6q-edm1-gnome-qca {
			description = "IMX6Q EDM1 GNOME QCA";
			kernel = "kernel@1";
			ramdisk = "ramdisk@1";
			fdt = "fdt@22";
		};
		config@imx6q-edm1-tc0700-qca {
			description = "IMX6Q EDM1 TC0700 QCA";
			kernel = "kernel@1";
			ramdisk = "ramdisk@1";
			fdt = "fdt@23";
		};
		config@imx6q-edm1-tc1000-qca {
			description = "IMX6Q EDM1 TC1000 QCA";
			kernel = "kernel@1";
			ramdisk = "ramdisk@1";
			fdt = "fdt@24";
		};
		/* imx6qp */
		config@imx6qp-edm1-fairy-qca {
			description = "IMX6QP EDM1 FAIRY QCA";
			kernel = "kernel@1";
			ramdisk = "ramdisk@1";
			fdt = "fdt@31";
		};
		config@imx6qp-edm1-gnome-qca {
			description = "IMX6QP EDM1 GNOME QCA";
			kernel = "kernel@1";
			ramdisk = "ramdisk@1";
			fdt = "fdt@32";
		};
		config@imx6qp-edm1-tc0700-qca {
			description = "IMX6QP EDM1 TC0700 QCA";
			kernel = "kernel@1";
			ramdisk = "ramdisk@1";
			fdt = "fdt@33";
		};
		config@imx6qp-edm1-tc1000-qca {
			description = "IMX6QP EDM1 TC1000 QCA";
			kernel = "kernel@1";
			ramdisk = "ramdisk@1";
			fdt = "fdt@34";
		};
	};
};
```

## board/technexion/edm-imx7d/Kconfig
```kconfig
if TARGET_EDM_IMX7D

config SYS_BOARD
	default "edm-imx7d"

config SYS_VENDOR
	default "technexion"

config SYS_SOC
	default "mx7"

config SYS_CONFIG_NAME
	default "edm-imx7d"

endif
```

## board/technexion/edm-imx7d/tnrescue.its
```
/*
 * U-Boot uImage source file with multiple kernels, ramdisks and FDT blobs
 */

/dts-v1/;

/ {
	description = "Various kernels, ramdisks and FDT blobs";
	#address-cells = <1>;

	images {
		kernel@1 {
			description = "TechNexion IMX6/IMX7 Linux Kernel";
			data = /incbin/("./zImage");
			type = "kernel";
			arch = "arm";
			os = "linux";
			compression = "none";
			load = <0x80800000>;
			entry = <0x80800000>;
			hash@1 {
				algo = "sha1";
			};
		};
		ramdisk@1 {
			description = "TechNexion Installer Ramdisk with Qt";
			data = /incbin/("./rootfs.cpio.xz");
			type = "ramdisk";
			arch = "arm";
			os = "linux";
			compression = "none";
			load = <0x83800000>;
			entry = <0x83800000>;
			hash@1 {
				algo = "sha1";
			};
		};
		fdt@1 {
			description = "imx7d edm1 gnome qca";
			data = /incbin/("./dtb/imx7d-edm1-gnome-qca.dtb");
			type = "flat_dt";
			arch = "arm";
			compression = "none";
			load = <0x83000000>;
			hash@1 {
				algo = "sha1";
			};
		};
		fdt@2 {
			description = "imx7d edm1 gnome qca m4";
			data = /incbin/("./dtb/imx7d-edm1-gnome-qca-m4.dtb");
			type = "flat_dt";
			arch = "arm";
			compression = "none";
			load = <0x83000000>;
			hash@1 {
				algo = "sha1";
			};
		};
	};

	configurations {
		config@imx7d-edm1-gnome-qca {
			description = "IMX7D EDM1 GNOME QCA";
			kernel = "kernel@1";
			ramdisk = "ramdisk@1";
			fdt = "fdt@1";
		};
		config@imx7d-edm1-gnome-qca-m4 {
			description = "IMX7D EDM1 QCA GNOME M4";
			kernel = "kernel@1";
			ramdisk = "ramdisk@1";
			fdt = "fdt@2";
		};
	};
};
```

## board/technexion/edm-imx8mq/Kconfig
```kconfig
if TARGET_EDM_IMX8MQ

config SYS_BOARD
	default "edm-imx8mq"

config SYS_VENDOR
	default "technexion"

config SYS_CONFIG_NAME
	default "edm-imx8mq"

endif
```

## board/technexion/edm-imx8mq/tnrescue.its
```
/*
 * U-Boot uImage source file with multiple kernels, ramdisks and FDT blobs
 */

/dts-v1/;

/ {
	description = "Various kernels, ramdisks and FDT blobs";
	#address-cells = <1>;

	images {
		kernel@1 {
			description = "Technexion IMX8 Linux Kernel";
			data = /incbin/("./Image");
			type = "kernel";
			arch = "arm64";
			os = "linux";
			compression = "none";
			load = <0x40480000>;
			entry = <0x40480000>;
			hash@1 {
				algo = "sha1";
			};
		};

		ramdisk@1 {
			description = "Technexion Installer/Rescue Ramdisk with Qt";
			data = /incbin/("./rootfs.cpio.xz");
			type = "ramdisk";
			arch = "arm64";
			os = "linux";
			compression = "none";
			load = <0x43800000>;
			entry = <0x43800000>;
			hash@1 {
				algo = "sha1";
			};
		};

		fdt@1 {
			description = "Edm imx8mq fairy with no display";
			data = /incbin/("./dtb/imx8mq-edm-fairy.dtb");
			type = "flat_dt";
			arch = "arm64";
			compression = "none";
			load = <0x43000000>;
			hash@1 {
				algo = "sha1";
			};
		};

		fdt@2 {
			description = "Edm imx8mq gnome with no display";
			data = /incbin/("./dtb/imx8mq-edm-gnome.dtb");
			type = "flat_dt";
			arch = "arm64";
			compression = "none";
			load = <0x43000000>;
			hash@1 {
				algo = "sha1";
			};
		};

		fdt@3 {
			description = "Edm imx8mq wizard with no display";
			data = /incbin/("./dtb/imx8mq-edm-wizard.dtb");
			type = "flat_dt";
			arch = "arm64";
			compression = "none";
			load = <0x43000000>;
			hash@1 {
				algo = "sha1";
			};
		};

		fdt@4 {
			description = "Edm imx8mm wizard for MIPI 5 inch panel";
			data = /incbin/("./dtb/imx8mq-edm-wizard-dcss-ili9881c.dtb");
			type = "flat_dt";
			arch = "arm64";
			compression = "none";
			load = <0x43000000>;
			hash@1 {
				algo = "sha1";
			};
		};

		fdt@5 {
			description = "Edm imx8mq wizard for MIPI 8 inch panel";
			data = /incbin/("./dtb/imx8mq-edm-wizard-dcss-g080uan01.dtb");
			type = "flat_dt";
			arch = "arm64";
			compression = "none";
			load = <0x43000000>;
			hash@1 {
				algo = "sha1";
			};
		};

		fdt@6 {
			description = "Edm imx8mq wizard for MIPI 10 inch panel";
			data = /incbin/("./dtb/imx8mq-edm-wizard-dcss-g101uan02.dtb");
			type = "flat_dt";
			arch = "arm64";
			compression = "none";
			load = <0x43000000>;
			hash@1 {
				algo = "sha1";
			};
		};

		fdt@7 {
			description = "Edm imx8mq wizard for MIPI to HDMI bridge";
			data = /incbin/("./dtb/imx8mq-edm-wizard-lcdif-adv7535.dtb");
			type = "flat_dt";
			arch = "arm64";
			compression = "none";
			load = <0x43000000>;
			hash@1 {
				algo = "sha1";
			};
		};
	};

	configurations {
		imx8mq-edm-fairy.dtb {
			description = "Boot IMX8mq fairy with no display";
			kernel = "kernel@1";
			ramdisk = "ramdisk@1";
			fdt = "fdt@1";
		};
		imx8mq-edm-gnome.dtb {
			description = "Boot IMX8mq gnome with no display";
			kernel = "kernel@1";
			ramdisk = "ramdisk@1";
			fdt = "fdt@2";
		};
		imx8mq-edm-wizard.dtb {
			description = "Boot IMX8mq wizard with no display";
			kernel = "kernel@1";
			ramdisk = "ramdisk@1";
			fdt = "fdt@3";
		};
		imx8mq-edm-wizard-dcss-ili9881c.dtb {
			description = "Boot IMX8mq with dcss 5 inch panel";
			kernel = "kernel@1";
			ramdisk = "ramdisk@1";
			fdt = "fdt@4";
		};
		imx8mq-edm-wizard-dcss-g080uan01.dtb {
			description = "Boot IMX8mq with dcss 8 inch panel";
			kernel = "kernel@1";
			ramdisk = "ramdisk@1";
			fdt = "fdt@5";
		};
		imx8mq-edm-wizard-dcss-g101uan02.dtb {
			description = "Boot IMX8mq with dcss 10 inch panel";
			kernel = "kernel@1";
			ramdisk = "ramdisk@1";
			fdt = "fdt@6";
		};
		imx8mq-edm-wizard-lcdif-adv7535.dtb {
			description = "Boot IMX8mq with lcdif and mipi to hdmi bridge";
			kernel = "kernel@1";
			ramdisk = "ramdisk@1";
			fdt = "fdt@7";
		};
	};
};
```

## board/technexion/edm-imx93/Kconfig
```kconfig
if TARGET_EDM_IMX93

config SYS_BOARD
	default "edm-imx93"

config SYS_VENDOR
	default "technexion"

config SYS_CONFIG_NAME
	default "edm-imx93"

config EDM_IMX93_LPDDR4X
	bool "Using LPDDR4X Timing and PMIC voltage"
	select IMX9_LPDDR4X
	help
	  Select the LPDDR4X timing and 0.6V VDDQ

source "board/technexion/common/Kconfig"

endif
```

## board/technexion/edm1-cf-imx6sx/Kconfig
```kconfig
if TARGET_EDM1_CF_IMX6SX

config SYS_BOARD
	default "edm1-cf-imx6sx"

config SYS_VENDOR
	default "technexion"

config SYS_SOC
	default "mx6"

config SYS_CONFIG_NAME
	default "edm1-cf-imx6sx"

endif
```

## board/technexion/flex-imx8mm/Kconfig
```kconfig
if TARGET_FLEX_IMX8MM

config SYS_BOARD
	default "flex-imx8mm"

config SYS_VENDOR
	default "technexion"

config SYS_CONFIG_NAME
	default "flex-imx8mm"

endif
```
